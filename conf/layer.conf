## conf/layer.conf
```bitbake
# We have a conf and classes directory, add to BBPATH
BBPATH := "${BBPATH}:${LAYERDIR}"

# We have a packages directory, add to BBFILES
BBFILES += "${LAYERDIR}/recipes-*/*/*.bb"
BBFILES += " ${LAYERDIR}/recipes-*/*/*.bbappend"

BBFILE_COLLECTIONS += "elt"
BBFILE_PATTERN_elt := "^${LAYERDIR}/"
BBFILE_PRIORITY_elt = "10"

LAYERDEPENDS_elt = "core \
                    xilinx"
```

## conf/machine/include/machine-av108-default.inc
```bitbake
# Default Xilinx BSP Machine settings

MACHINE_FEATURES_BACKFILL_CONSIDERED += "rtc"

# File System Configuration
IMAGE_FSTYPES ?= "tar.gz cpio cpio.gz.u-boot"
IMAGE_CLASSES += "image_types_uboot"

# Kernel Configuration
XILINX_DEFAULT_KERNEL := "linux-apissys"

PREFERRED_PROVIDER_virtual/kernel ??= "${XILINX_DEFAULT_KERNEL}"
PREFERRED_VERSION_linux-apissys ?= "3.15"

# U-Boot Configuration
PREFERRED_PROVIDER_virtual/bootloader ??= "u-boot-apissys"
PREFERRED_VERSION_u-boot-apissys ?= "2014.1"

UBOOT_SUFFIX ?= "img"
UBOOT_SUFFIX_zynqmp ?= "bin"
UBOOT_BINARY ?= "u-boot.${UBOOT_SUFFIX}"
UBOOT_BINARY_zynq ?= "u-boot-dtb.${UBOOT_SUFFIX}"

# Device Trees
MACHINE_ESSENTIAL_EXTRA_RDEPENDS_append_zynq += "device-tree"
MACHINE_ESSENTIAL_EXTRA_RDEPENDS_append_microblaze += "device-tree"
```

## recipes-support/conf/machine/av108.conf
```bitbake
#@TYPE: Machine
#@NAME: av108
#@DESCRIPTION: Machine support for av108

require conf/machine/include/tune-zynq.inc
require conf/machine/include/machine-av108-default.inc
require conf/machine/include/machine-xilinx-board.inc

MACHINE_FEATURES = "ext2 vfat usbhost"

# microZed machine definition known by Xilinx UBOOT
UBOOT_MACHINE = "zynq_av108_config"

SERIAL_CONSOLE = "115200 ttyPS0"

MACHINE_DEVICETREE := " \
		av108/av108.dts \
		"

IMAGE_BOOT_FILES += "boot.bin ${MACHINE}.dtb"

EXTRA_IMAGEDEPENDS += "virtual/boot-bin"
PREFERRED_PROVIDER_virtual/kernel = "linux-adi-hh"
```
